## firmware/components/aai_device/Kconfig
```kconfig
menu "AAI Voice Device"

    config AAI_WIFI_SSID
        string "Wi-Fi SSID"
        default ""
        help
            Empty (the default for a speaker you hand to someone): the network saved on the
            device, set from a phone. With none saved, the speaker opens an access point
            named AAI-xxxxxx and the ring glows amber; the ESP SoftAP Prov app (iOS/Android)
            joins it and sends the home network. Set, it overrides whatever is saved.

    config AAI_WIFI_PASSWORD
        string "Wi-Fi password"
        default ""

    config AAI_PROV_POP
        string "Wi-Fi setup code (proof of possession)"
        default "aai-speaker"
        help
            Asked for by the provisioning app; it keys the encryption of the Wi-Fi password
            on its way to the speaker. Empty: no code (anyone in range can set the network).

    config AAI_PROV_FALLBACK_S
        int "Open Wi-Fi setup when the saved network is unreachable (s)"
        default 120
        range 0 3600
        help
            A saved network that doesn't connect for this long after boot (it moved house,
            the password changed) opens the setup access point beside the retries. 0: never.
            Not used with a compiled-in SSID.

    config AAI_AGENT_URL
        string "Agent WebSocket URL"
        default ""
        help
            The /websocket endpoint of the voice agent, e.g. ws://192.168.1.10:3000/websocket.
            Empty: found on the LAN over mDNS, where `make agent` advertises itself
            (_aai._tcp), and followed when the laptop's address changes. A .local host name
            (ws://my-mac.local:3000/websocket) also works.

    config AAI_DEVICE_ADDRESS
        string "Device street address"
        default ""
        help
            Where the speaker is, e.g. "123 Example St, Portland, OR 97201". Sent to the
            agent as ?location= on connect so "coffee near me" and "what's the weather" mean
            here. Separate street, town and region with commas. Empty sends nothing.

    config AAI_CLIENT_ID
        string "Device id"
        default ""
        help
            Names this speaker to the agent: sent as ?client= on voice sessions and used
            for the inbox socket (WS /inbox) that reminders are pushed to. 1-64 of
            A-Z a-z 0-9 _ -. Empty uses "speaker-" and the end of the Wi-Fi MAC.

    config AAI_FOLLOWUP_MS
        int "Follow-up window (ms)"
        default 3000
        help
            After the agent finishes speaking, keep listening this long for a follow-up
            before hanging up and going back to wake word detection.

    config AAI_FULL_DUPLEX
        bool "Stream the mic to the agent while it is speaking"
        default n
        help
            Off (default, like commercial smart speakers): while the agent talks,
            only the on-device wake word listens, and saying it interrupts. On:
            you can interrupt by just talking, but residual speaker echo can reach
            the agent's speech recognition and make it answer itself. Only enable
            with good acoustic separation (external speaker, low volume).

    config AAI_VOLUME
        int "Speaker volume (0-100)"
        range 0 100
        default 70

    config AAI_OTA_URL
        string "Firmware update URL"
        default ""
        help
            Where to fetch firmware updates: an http:// or https:// URL of aai_device.bin,
            e.g. http://my-mac.local:8070/aai_device.bin for `make ota-serve`. Checked a
            minute after boot and every AAI_OTA_CHECK_HOURS; an image whose version differs
            from the running one is downloaded while idle and booted into. Empty: no updates.

    config AAI_OTA_CHECK_HOURS
        int "Hours between firmware update checks"
        range 1 168
        default 6

endmenu
```
